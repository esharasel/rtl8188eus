## Kconfig
```kconfig
config RTL8188EU
	tristate "Realtek 8188E USB WiFi"
	depends on USB
	---help---
	  Help message of RTL8188EU
Tp-link router
Ssid:-Munny.net
Bssid:-c8:e7:d8:8d:e7:a4
Password:-wpa_wpa2
Please help i need ihis wifi password
Someone please help   
```
